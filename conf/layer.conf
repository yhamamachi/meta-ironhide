## conf/machine/ironhide.conf
```bitbake
#@TYPE: Machine
#@NAME: Ironhide machine
#@DESCRIPTION: Machine configuration for running ironhide

SOC_FAMILY = "r8a78000"
SOC_FAMILY =. "rcar-gen5:"

require conf/machine/include/soc-family.inc

MACHINE_FEATURES = ""
# Add variable to Build Configuration in build log
BUILDCFG_VARS:append = " SOC_FAMILY"

# Configuration for kernel
PREFERRED_PROVIDER_virtual/kernel ?= "linux-renesas"
KERNEL_IMAGETYPE = "Image"
IMAGE_FSTYPES += " tar.bz2 ext4 wic.gz wic.bmap"
# Device tree
KERNEL_DEVICETREE = "\
    renesas/r8a78000-ironhide.dtb \
"
SERIAL_CONSOLES = "1843200;ttySC0"

# Configuration for ARM Trusted Firmware
EXTRA_IMAGEDEPENDS += " arm-trusted-firmware"

# Configuration for SCP Firmware
EXTRA_IMAGEDEPENDS += " scp-firmware"

# u-boot
EXTRA_IMAGEDEPENDS += " u-boot"
# u-boot configure
UBOOT_MACHINE = "r8a78000_ironhide_defconfig"

WKS_FILE ?= "rcar-singlepart-noloader.wks"

DEFAULTTUNE ?= "aarch64"
require conf/machine/include/arm/arch-arm64.inc

MACHINE_EXTRA_RRECOMMENDS = " \
    kernel-image kernel-devicetree kernel-modules u-boot \
"
```
